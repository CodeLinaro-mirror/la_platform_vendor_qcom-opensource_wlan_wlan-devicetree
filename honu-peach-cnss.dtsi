// SPDX-License-Identifier: BSD-3-Clause
/*
 * Copyright (c) Qualcomm Technologies, Inc. and/or its subsidiaries.
 */

&reserved_memory {
	cnss_wlan_mem: cnss_wlan_region {
		compatible = "shared-dma-pool";
		alloc-ranges = <0x0 0x00000000 0x0 0xffffffff>;
		reusable;
		alignment = <0x0 0x400000>;
		size = <0x0 0x2000000>;
	};
};

&soc {
	wlan_peach: qcom,cnss-peach@b0000000 {
		compatible = "qcom,cnss-peach";
		reg = <0x0 0xb0000000 0x0 0x10000>;
		reg-names = "smmu_iova_ipa";

		supported-ids = <0x110E>;
		qcom,wlan-ramdump-dynamic = <0x600000>;
		cnss-enable-self-recovery;
		qcom,wlan-cbc-enabled;
		use-pm-domain;
		qcom,same-dt-multi-dev;
		qcom,qmp = <&aoss_qmp>;
		platform-name-required;
		caldb-rddm-reuse-supported;
		qcom,wlan;
		wlan-txrx-intr-cpumask = <0x3 0x30>;
	};
};
