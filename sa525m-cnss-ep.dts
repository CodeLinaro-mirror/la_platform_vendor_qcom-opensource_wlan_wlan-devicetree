// SPDX-License-Identifier: BSD-3-Clause
//Copyright (c) Qualcomm Technologies, Inc. and/or its subsidiaries.
/dts-v1/;
/plugin/;

#include "sa525m-cnss.dtsi"

/ {
	model = "Qualcomm Technologies, Inc. SA525M CNSS PCIe-EP";
	compatible = "qcom,sdxpinn";
	qcom,msm-id = <558 0x10000>, <559 0x10000>;
	qcom,board-id = <0x0010022 0x20006>, <0x0020022 0x20006>,
			 <0x0030022 0x20006>, <0x0010122 0x20006>;
};

&cnss_pci_iommu_group {
	qcom,iommu-dma = "bypass";
};

&cnss_wlan_mem {
	size = <0x0 0x2000000>;
};
