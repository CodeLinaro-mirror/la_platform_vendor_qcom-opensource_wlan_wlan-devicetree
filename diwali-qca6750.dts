// SPDX-License-Identifier: BSD-3-Clause
/*
 * Copyright (c) Qualcomm Technologies, Inc. and/or its subsidiaries.
 */

/dts-v1/;
/plugin/;

#include "diwali-qca6750.dtsi"

/ {
	model = "Qualcomm Technologies, Inc. Diwali SoC";
	compatible = "qcom,diwali";
	qcom,msm-id = <564 0x10000>, <547 0x10000>, <506 0x10000>;
	qcom,board-id =  <34 3>, <33 0>, <34 2>, <34 0>, <34 1>, <0x1000B 0>,
					<0 0>, <0 2>, <0x1000F 0>, <15 0>;
};
