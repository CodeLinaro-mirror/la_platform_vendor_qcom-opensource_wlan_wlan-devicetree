// SPDX-License-Identifier: BSD-3-Clause

/*
 * Copyright (c) Qualcomm Technologies, Inc. and/or its subsidiaries.
 */

/dts-v1/;
/plugin/;

#include "x1p42100-kiwi-cnss.dtsi"

/ {
	model = "Qualcomm Technologies, Inc. X1P42100 SoC";
	compatible = "qcom,x1p42100";
	qcom,msm-id = <635 0x10000>, <799 0x10000>;
	qcom,board-id = <40 0>, <0x10022 1>, <0x20022 1>, <0x30022 1>, <0x10022 0>, <0x20022 0>, <0x30022 0>;
};
